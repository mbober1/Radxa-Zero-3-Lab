// SPDX-License-Identifier: (GPL-2.0+ OR MIT)
/*
 * Copyright (c) 2022 Rockchip Electronics Co., Ltd.
 * Copyright (c) 2023 Radxa Limited.
 *
 */

/dts-v1/;

#include "rk3566-radxa-zero3.dtsi"

/ {
	model = "Radxa ZERO 3";
	compatible = "radxa,zero-3e", "radxa,zero3", "rockchip,rk3566";


	gpio_leds: gpio-leds {
		compatible = "gpio-leds";
		status = "okay";

		board-led {
			gpios = <&gpio0 RK_PA0 GPIO_ACTIVE_HIGH>;
			pinctrl-0 = <&board_led>;
			linux,default-trigger = "activity";
		};
	};
};

&hdmi_in_vp0 {
	status = "disabled";
};