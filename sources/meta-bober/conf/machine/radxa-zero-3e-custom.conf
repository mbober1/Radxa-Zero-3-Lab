## sources/meta-bober/conf/machine/radxa-zero-3e-custom.conf
```bitbake
#@TYPE: Machine
#@NAME: Radxa Zero 3E Custom
#@DESCRIPTION: Custom machine for Radxa Zero 3E
#http://radxa.com/products/zeros/zero3e/

require conf/machine/include/radxa-zero-3.inc
KERNEL_DEVICETREE = "rockchip/rk3566-radxa-zero-3e.dtb"

IMAGE_FSTYPES = "wic.zst"
```

## sources/meta-bober/conf/machine/radxa-zero-3e-joshua.conf
```bitbake
#@TYPE: Machine
#@NAME: Radxa Zero 3W

require conf/machine/include/rk3566.inc

MACHINEOVERRIDES =. "radxa-cm3-io"

KERNEL_DEVICETREE = "rockchip/rk3566-radxa-zero3.dtb"
MACHINE_EXTRA_RRECOMMENDS += "kernel-modules"

UBOOT_MACHINE = "radxa-zero3-rk3566_defconfig"
IMAGE_FSTYPES = "wic.zst"

PREFERRED_PROVIDER_virtual/kernel = "linux-yocto-joshua"
```

## sources/meta-bober/conf/machine/radxa-zero-3e.conf
```bitbake
#@TYPE: Machine
#@NAME: Radxa Zero 3W

require conf/machine/include/rk356x.inc
MACHINEOVERRIDES =. "rockchip-rk3566-radxa-cm3-io"
KERNEL_DEVICETREE = "rockchip/rk3566-radxa-zero-3e.dtb"

UBOOT_MACHINE = "rk3568_defconfig"

MACHINE_EXTRA_RRECOMMENDS:append = " \
	drm-cursor \
"

IMAGE_INSTALL:append = " \
	kernel-modules \
"

PREFERRED_PROVIDER_virtual/libopencl = "mesa"
PREFERRED_PROVIDER_virtual/libgbm = "mesa"
PREFERRED_PROVIDER_virtual/xserver = "xserver-xorg"
PREFERRED_PROVIDER_virtual/xserver-xf86 = "xserver-xorg"
PREFERRED_PROVIDER_virtual/egl = "mesa"
PREFERRED_PROVIDER_virtual/libgl = "mesa"
PREFERRED_PROVIDER_virtual/libgl-native = "mesa-native"
PREFERRED_PROVIDER_virtual/nativesdk-libgl = "nativesdk-mesa"
PREFERRED_PROVIDER_virtual/libgles1 = "mesa"
PREFERRED_PROVIDER_virtual/libgles2 = "mesa"
PREFERRED_PROVIDER_virtual/libgles3 = "mesa"
PREFERRED_PROVIDER_virtual/mesa = "mesa"

IMAGE_FSTYPES ?= "wic.zst"

RK_WIFIBT_FIRMWARES = ""
```
